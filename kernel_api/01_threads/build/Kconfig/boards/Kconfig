## kernel_api/01_threads/build/Kconfig/boards/Kconfig
```kconfig
# Load Zephyr board Kconfig descriptions.
osource "/home/priya/zephyrproject/zephyr/boards/st/nucleo_f401re/Kconfig"
```

## kernel_api/01_threads/build/Kconfig/boards/Kconfig.defconfig
```kconfig
# Load Zephyr board defconfig descriptions.
osource "/home/priya/zephyrproject/zephyr/boards/st/nucleo_f401re/Kconfig.defconfig"
```

## kernel_api/01_threads/build/Kconfig/boards/Kconfig.sysbuild
```kconfig
# Load Sysbuild board Kconfig descriptions.
osource "/home/priya/zephyrproject/zephyr/boards/st/nucleo_f401re/Kconfig.sysbuild"
```

## kernel_api/02_thread_scheduling/cooperative_thread/build/Kconfig/arch/Kconfig
```kconfig
# Load Zephyr Arch Kconfig descriptions.
osource "/home/priya/zephyrproject/zephyr/arch/rx/Kconfig"
osource "/home/priya/zephyrproject/zephyr/arch/x86/Kconfig"
osource "/home/priya/zephyrproject/zephyr/arch/xtensa/Kconfig"
osource "/home/priya/zephyrproject/zephyr/arch/sparc/Kconfig"
osource "/home/priya/zephyrproject/zephyr/arch/riscv/Kconfig"
osource "/home/priya/zephyrproject/zephyr/arch/posix/Kconfig"
osource "/home/priya/zephyrproject/zephyr/arch/mips/Kconfig"
osource "/home/priya/zephyrproject/zephyr/arch/arm64/Kconfig"
osource "/home/priya/zephyrproject/zephyr/arch/arm/Kconfig"
osource "/home/priya/zephyrproject/zephyr/arch/arc/Kconfig"
```

## kernel_api/02_thread_scheduling/cooperative_thread/build/Kconfig/boards/Kconfig.sysbuild
```kconfig
# Load Sysbuild board Kconfig descriptions.
osource "/home/priya/zephyrproject/zephyr/boards/st/nucleo_f411re/Kconfig.sysbuild"
```

## kernel_api/02_thread_scheduling/preemptive_demo/build/Kconfig/boards/Kconfig
```kconfig
# Load Zephyr board Kconfig descriptions.
osource "/home/priya/zephyrproject/zephyr/boards/st/nucleo_f411re/Kconfig"
```

## kernel_api/02_thread_scheduling/preemptive_demo/build/Kconfig/boards/Kconfig.nucleo_f411re
```kconfig
# Load board Kconfig descriptions.
osource "/home/priya/zephyrproject/zephyr/boards/st/nucleo_f411re/Kconfig.nucleo_f411re"
```
