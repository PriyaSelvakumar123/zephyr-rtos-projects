## CMakeLists.txt
```
cmake_minimum_required(VERSION 3.20.0)

find_package(Zephyr REQUIRED HINTS $ENV{ZEPHYR_BASE})

project(vtask_1)

target_sources(app PRIVATE

	src/main.c
)
```

## prj.conf
```kconfig
CONFIG_GPIO=y
CONFIG_MAIN_STACK_SIZE=2048


CONFIG_SERIAL=y
CONFIG_CONSOLE=y
CONFIG_UART_CONSOLE=y
```

## app.overlay
```dts
/ {
	aliases {
		led1 = &external_led;
	};

	leds {
		compatible = "gpio-leds";

		external_led: external_led {
			gpios = <&gpioa 9 GPIO_ACTIVE_HIGH>;
			label = "External LED";
		};
	};
};
```

## src/main.c
```c
#include <zephyr/kernel.h>
#include <zephyr/device.h>
#include <zephyr/drivers/gpio.h>

/* Onboard LED */
#define LED0_NODE DT_ALIAS(led0)
static const struct gpio_dt_spec led0 =
	GPIO_DT_SPEC_GET(LED0_NODE, gpios);

/* External LED */
#define LED1_NODE DT_ALIAS(led1)
static const struct gpio_dt_spec led1 =
	GPIO_DT_SPEC_GET(LED1_NODE, gpios);

/* Thread 0 : Onboard LED */
void thread0(void *p1, void *p2, void *p3)
{
	ARG_UNUSED(p1);
	ARG_UNUSED(p2);
	ARG_UNUSED(p3);

	while (1) {
		gpio_pin_toggle_dt(&led0);
		k_msleep(500);
	}
}

/* Thread 1 : External LED */
void thread1(void *p1, void *p2, void *p3)
{
	ARG_UNUSED(p1);
	ARG_UNUSED(p2);
	ARG_UNUSED(p3);

	while (1) {
		gpio_pin_toggle_dt(&led1);
		k_msleep(2000);
	}
}

/* Create Threads */
K_THREAD_DEFINE(thread0_id,
		1024,
		thread0,
		NULL, NULL, NULL,
		3,
		0,
		0);

K_THREAD_DEFINE(thread1_id,
		1024,
		thread1,
		NULL, NULL, NULL,
		5,
		0,
		0);

int main(void)
{
	if (!gpio_is_ready_dt(&led0)) {
		return 0;
	}

	if (!gpio_is_ready_dt(&led1)) {
		return 0;
	}

	gpio_pin_configure_dt(&led0, GPIO_OUTPUT_ACTIVE);
	gpio_pin_configure_dt(&led1, GPIO_OUTPUT_ACTIVE);

	while (1) {
		k_sleep(K_SECONDS(1));
	}

	return 0;
}
```
